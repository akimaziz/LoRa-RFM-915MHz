#include <RH_RF95.h>
#include <DHT.h>
#include <Adafruit_PCD8544.h>
#include <Adafruit_GFX.h>

// Define YouTube symbol bitmap data
#define YOUTUBE_WIDTH  84
#define YOUTUBE_HEIGHT 48
#define intelkecik_lebar 44
#define intelkecik_tinggi 28
#define inteli9_lebar 44
#define inteli9_tinggi 28
#define palestin_WIDTH  84
#define palestin_HEIGHT 48

static const unsigned char PROGMEM youtube_bitmap[] = {
  0x00, 0x00, 0x00, 0x00, 0x00, 0x00, 0x00, 0x00, 0x00, 0x00, 0x00, 0x00, 0x00, 0x00, 0x00, 0x00, 
  0x1f, 0xff, 0xff, 0x00, 0x00, 0x00, 0x00, 0x00, 0x00, 0x00, 0x07, 0xff, 0xff, 0xff, 0xf8, 0x00, 
  0x00, 0x00, 0x00, 0x00, 0x00, 0x7f, 0x80, 0x00, 0x01, 0xff, 0x00, 0x00, 0x00, 0x00, 0x00, 0x03, 
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  0x00, 0x00, 0x00, 0x00, 0x00, 0x00, 0x00, 0x00, 0x00, 0x00, 0x00, 0x00, 0x00, 0x00, 0x00, 0x00
};
static const unsigned char PROGMEM intelkecik_bitmap[] = {
 0x7f, 0xff, 0xff, 0xc3, 0xff, 0xe0, 0x7f, 0xff, 0xf0, 0x38, 0x1f, 0xe0, 0x7f, 0xff, 0x1f, 0xff, 
 0xe7, 0xe0, 0x7f, 0xfc, 0xff, 0xff, 0xf9, 0xe0, 0x7f, 0xf7, 0xff, 0xff, 0xfc, 0xe0, 0x7f, 0xff, 
  0xff, 0xff, 0xfe, 0x60, 0x7f, 0xff, 0xff, 0xff, 0xff, 0x60, 0x7e, 0x7f, 0xff, 0xff, 0x9f, 0x20, 
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  0xff, 0xe0, 0x7f, 0xff, 0xff, 0xff, 0xff, 0xe0
};
static const unsigned char PROGMEM inteli9_bitmap[] = {
 0x00, 0xff, 0xff, 0xff, 0xf0, 0x00, 0x00, 0xff, 0xff, 0xff, 0xf0, 0x00, 0x00, 0xff, 0xff, 0xff, 
 0xf0, 0x00, 0x00, 0xff, 0xff, 0xff, 0xf0, 0x00, 0x00, 0xff, 0xc0, 0x3f, 0xf0, 0x00, 0x00, 0xfe, 
  0x00, 0x07, 0xf0, 0x00, 0x00, 0xf8, 0x3f, 0xc1, 0xf0, 0x00, 0x00, 0xe1, 0xff, 0xf8, 0xf0, 0x00, 
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  0xf0, 0x00, 0x00, 0xff, 0xff, 0xff, 0xf0, 0x00
};
static const unsigned char PROGMEM palestin_bitmap[] = {
 0x00, 0x00, 0x3f, 0xff, 0xff, 0xff, 0xff, 0xff, 0xc0, 0x00, 0x00, 0x00, 0x00, 0x3f, 0xff, 0xff, 
 0xff, 0xff, 0xff, 0xc0, 0x00, 0x00, 0x00, 0x00, 0x3f, 0xff, 0xff, 0xff, 0xff, 0xff, 0xc0, 0x00, 
  0x00, 0x00, 0x00, 0x3f, 0xff, 0xff, 0xff, 0xff, 0xff, 0xc0, 0x00, 0x00, 0x00, 0x00, 0x3f, 0xff, 
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  0xff, 0xff, 0xc0, 0x00, 0x00, 0x00, 0x00, 0x3f, 0xff, 0xff, 0xff, 0xff, 0xff, 0xc0, 0x00, 0x00
};


#define RFM95_CS 10
#define RFM95_RST 7  
#define RFM95_INT 2

#define RF95_FREQ 915.0

Adafruit_PCD8544 lcd = Adafruit_PCD8544(24, 26, 28, 30, 32);
RH_RF95 rf95(RFM95_CS, RFM95_INT);

#define DHTPIN 47
#define DHTTYPE DHT11
DHT dht(DHTPIN, DHTTYPE);

void setup() {
  
  lcd.begin();
  lcd.setContrast(57);
  pinMode(RFM95_RST, OUTPUT);
  digitalWrite(RFM95_RST, HIGH);

  while (!Serial);
  Serial.begin(9600);
  delay(100);

  Serial.println("LoRa TX Test!");
  lcd.clearDisplay();
  
  // Display YouTube symbol
  lcd.drawBitmap(0, 0, youtube_bitmap, YOUTUBE_WIDTH, YOUTUBE_HEIGHT, BLACK);
  lcd.display();
  delay(3000);
  lcd.clearDisplay();
  lcd.drawBitmap(0, 0, palestin_bitmap, palestin_WIDTH, palestin_HEIGHT, BLACK);
  lcd.display();
  delay(3000);
  lcd.clearDisplay();

  digitalWrite(RFM95_RST, LOW);
  delay(10);
  digitalWrite(RFM95_RST, HIGH);
  delay(10);

  while (!rf95.init()) {
    Serial.println("LoRa radio init failed");
    while (1);
  }
  Serial.println("LoRa radio init OK!");
  lcd.setCursor(0,10);
  lcd.print("  TEMPERATURE");
  lcd.setCursor(0,20);
  lcd.print("     AND");
  lcd.setCursor(0,30);
  lcd.print("   HUMIDITY");
  lcd.setCursor(0,40);
  lcd.print("   INDICATOR");
  lcd.display();
  lcd.clearDisplay();
  delay(2000);
  //lcd.clearDisplay();
  lcd.setCursor(0,0);
  lcd.print("Initialization");
  delay(2000);
  lcd.display();
  lcd.clearDisplay();
  lcd.setCursor(0,0);
  lcd.print("Initialization");
  lcd.setCursor(0,10);
  lcd.print("LoRa Connected");
  delay(2000);
  lcd.display();
  lcd.clearDisplay();
  lcd.setCursor(0,0);
  lcd.print("Initialization");
  lcd.setCursor(0,10);
  lcd.print("LoRa Connected");
  lcd.setCursor(0,30);
  lcd.print("prepared by:");
  delay(2000);
  lcd.display();
  lcd.clearDisplay();
  lcd.setCursor(0,0);
  lcd.print("Initialization");
  lcd.setCursor(0,10);
  lcd.print("LoRa Connected");
  lcd.setCursor(0,30);
  lcd.print("prepared by:");
  lcd.setCursor(0,40);
  lcd.print("Hakimi Azizan");
  delay(1000);
  lcd.display();
  lcd.clearDisplay();
  delay(1000);
  
  if (!rf95.setFrequency(RF95_FREQ)) {
    Serial.println("setFrequency failed");
    while (1);
  }
  Serial.print("Set Freq to: "); Serial.println(RF95_FREQ);

  rf95.setTxPower(23, false);

  dht.begin();
}

int16_t packetnum = 0;

void loop() {
  float h = dht.readHumidity();
  float t = dht.readTemperature();

  if (isnan(h) || isnan(t)) {
    Serial.println("Failed to read from DHT sensor!");
    return;
  }

  Serial.print("Temperature: "); Serial.print(t); Serial.println(" *C");
  Serial.print("Humidity: "); Serial.print(h); Serial.println(" %");

  
  lcd.drawBitmap(0, 20, intelkecik_bitmap, intelkecik_lebar, intelkecik_tinggi, BLACK);
  lcd.drawBitmap(47, 20, inteli9_bitmap, inteli9_lebar, inteli9_tinggi, BLACK);
  lcd.setCursor(0,0);
  lcd.print("Temp: ");
  lcd.print(t);
  lcd.print(" *C");
  lcd.display();
  lcd.setCursor(0,10);
  lcd.print("Humid: ");
  lcd.print(h);
  lcd.print(" %");
  lcd.display();
  lcd.clearDisplay();
  String data = "Temperature: " + String(t) + ", Humidity: " +String(h); 
  
  
  Serial.println("Sending to rf95_server: " + data); 
  rf95.send((uint8_t*)data.c_str(), data.length() + 1);
  

  Serial.println("Waiting for packet to complete...");
  rf95.waitPacketSent();

  delay(900);
}
